## cpu/arm/v6-m/Kconfig
```kconfig
#
# Kconfig
#
# Copyright (C) 2023 Mateusz Stadnik <matgla@live.com>
#
# This program is free software: you can redistribute it and/or
# modify it under the terms of the GNU General Public License
# as published by the Free Software Foundation, either version
# 3 of the License, or (at your option) any later version.
#
# This program is distributed in the hope that it will be
# useful, but WITHOUT ANY WARRANTY; without even the implied
# warranty of MERCHANTABILITY or FITNESS FOR A PARTICULAR
# PURPOSE. See the GNU General Public License for more details.
#
# You should have received a copy of the GNU General
# Public License along with this program. If not, see
# <https://www.gnu.org/licenses/>.
#

config CPU_ARCHITECTURE_ARMV6_M 
  bool "ARMv6-M"

config CPU_ARCHITECTURE
  def_string "v6-m"
  depends on CPU_ARCHITECTURE_ARMV6_M 

if CPU_ARCHITECURE_ARMV6_M 
  choice CHOICE_CPU_FAMILY
    default CPU_FAMILY_ARM
  endchoice 
endif 
```

## cpu/arm/v6-m/rp2040/Kconfig
```kconfig
#
# Kconfig
#
# Copyright (C) 2023 Mateusz Stadnik <matgla@live.com>
#
# This program is free software: you can redistribute it and/or
# modify it under the terms of the GNU General Public License
# as published by the Free Software Foundation, either version
# 3 of the License, or (at your option) any later version.
#
# This program is distributed in the hope that it will be
# useful, but WITHOUT ANY WARRANTY; without even the implied
# warranty of MERCHANTABILITY or FITNESS FOR A PARTICULAR
# PURPOSE. See the GNU General Public License for more details.
#
# You should have received a copy of the GNU General
# Public License along with this program. If not, see
# <https://www.gnu.org/licenses/>.
#

config CPU_RP2040
  bool "RP2040"

config CPU 
  def_string "rp2040" if CPU_RP2040
  depends on CPU_RP2040

if CPU_RP2040
  choice CHOICE_CPU_ARCHITECTURE
    default CPU_ARCHITECTURE_ARMV6_M 
  endchoice
endif
```

## cpu/host/arch/Kconfig
```kconfig
#
# Kconfig
#
# Copyright (C) 2023 Mateusz Stadnik <matgla@live.com>
#
# This program is free software: you can redistribute it and/or
# modify it under the terms of the GNU General Public License
# as published by the Free Software Foundation, either version
# 3 of the License, or (at your option) any later version.
#
# This program is distributed in the hope that it will be
# useful, but WITHOUT ANY WARRANTY; without even the implied
# warranty of MERCHANTABILITY or FITNESS FOR A PARTICULAR
# PURPOSE. See the GNU General Public License for more details.
#
# You should have received a copy of the GNU General
# Public License along with this program. If not, see
# <https://www.gnu.org/licenses/>.
#

config CPU_ARCHITECTURE_HOST 
  bool "host"

config CPU_ARCHITECTURE
  def_string "host" if CPU_ARCHITECTURE_HOST 
  depends on CPU_ARCHITECTURE_HOST 

if CPU_ARCHITECTURE_HOST 
  choice CHOICE_CPU_FAMILY 
    default CPU_FAMILY_HOST 
  endchoice
endif
```

## cpu/host/arch/cpu/Kconfig
```kconfig
#
# Kconfig
#
# Copyright (C) 2023 Mateusz Stadnik <matgla@live.com>
#
# This program is free software: you can redistribute it and/or
# modify it under the terms of the GNU General Public License
# as published by the Free Software Foundation, either version
# 3 of the License, or (at your option) any later version.
#
# This program is distributed in the hope that it will be
# useful, but WITHOUT ANY WARRANTY; without even the implied
# warranty of MERCHANTABILITY or FITNESS FOR A PARTICULAR
# PURPOSE. See the GNU General Public License for more details.
#
# You should have received a copy of the GNU General
# Public License along with this program. If not, see
# <https://www.gnu.org/licenses/>.
#

config CPU_HOST 
  bool "host cpu"

config CPU 
  def_string "host" if CPU_HOST 
  depends on CPU_HOST 

if CPU_HOST 
  choice CHOICE_CPU_ARCHITECTURE
    default CPU_ARCHITECTURE_HOST
  endchoice
endif 
```

## features_configs/interfaces/user/Kconfig
```kconfig
#!/usr/bin/env zsh
#
# Kconfig
#
# Copyright (C) 2024 Mateusz Stadnik <matgla@live.com>
#
# This program is free software: you can redistribute it and/or
# modify it under the terms of the GNU General Public License
# as published by the Free Software Foundation, either version
# 3 of the License, or (at your option) any later version.
#
# This program is distributed in the hope that it will be
# useful, but WITHOUT ANY WARRANTY; without even the implied
# warranty of MERCHANTABILITY or FITNESS FOR A PARTICULAR
# PURPOSE. See the GNU General Public License for more details.
#
# You should have received a copy of the GNU General
# Public License along with this program. If not, see
# <https://www.gnu.org/licenses/>.
#

config YASBOOT_INTERACTIVE
  bool "Enable interactive user interface"

choice
  prompt "Interface type"
  depends on YASBOOT_INTERACTIVE

  config YASBOOT_SERIAL_CONSOLE_INTERFACE
    bool "console"

  config YASBOOT_GUI_INTERFACE 
    bool "graphical user interface"
endchoice

choice 
  prompt "Console interface"
  depends on YASBOOT_SERIAL_CONSOLE_INTERFACE

  config YASBOOT_SERIAL_CONSOLE_UART
    bool "UART"

  config YASBOOT_SERIAL_CONSOLE_GUI
    bool "Video Output"
endchoice
```

## features_configs/yasld/Kconfig
```kconfig
#!/usr/bin/env zsh
#
# Kconfig
#
# Copyright (C) 2024 Mateusz Stadnik <matgla@live.com>
#
# This program is free software: you can redistribute it and/or
# modify it under the terms of the GNU General Public License
# as published by the Free Software Foundation, either version
# 3 of the License, or (at your option) any later version.
#
# This program is distributed in the hope that it will be
# useful, but WITHOUT ANY WARRANTY; without even the implied
# warranty of MERCHANTABILITY or FITNESS FOR A PARTICULAR
# PURPOSE. See the GNU General Public License for more details.
#
# You should have received a copy of the GNU General
# Public License along with this program. If not, see
# <https://www.gnu.org/licenses/>.
#

menu "yasld"
  config YASLD_ENABLED
    bool "Enable dynamic linker support"

  config YASLD_LOGGER_ENABLED
    bool "Enable logger"

  choice 
    prompt "Log level"
    depends on YASLD_ENABLED && YASLD_LOGGER_ENABLED

    config YASLD_LOGGER_ERROR 
      bool "Error"

    config YASLD_LOGGER_WARNING
      bool "Warning"

    config YASLD_LOGGER_INFO 
      bool "Info"

    config YASLD_LOGGER_DEBUG 
      bool "Debug"
    
  endchoice 
endmenu
```
